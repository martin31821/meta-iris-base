## meta-iris-base-common/conf/layer.conf
```bitbake
# SPDX-License-Identifier: MIT
# Copyright (C) 2021 iris-GmbH infrared & intelligent sensors

# We have a conf and classes directory, add to BBPATH
BBPATH .= ":${LAYERDIR}"

# We have a recipes-* directories, add to BBFILES
BBFILES += "${LAYERDIR}/recipes-*/*/*.bb \
	${LAYERDIR}/recipes-*/*/*.bbappend"

BBFILE_COLLECTIONS += "iris-base-common"
BBFILE_PATTERN_iris-base-common = "^${LAYERDIR}/"
BBFILE_PRIORITY_iris-base-common = "15"

LAYERDEPENDS_iris-base-common = "core \
                                 openembedded-layer"

LAYERSERIES_COMPAT_iris-base-common = "dunfell"
```

## meta-iris-base-hw1/conf/layer.conf
```bitbake
# SPDX-License-Identifier: MIT
# Copyright (C) 2021 iris-GmbH infrared & intelligent sensors

# We have a conf and classes directory, add to BBPATH
BBPATH .= ":${LAYERDIR}"

# We have a recipes-* directories, add to BBFILES
BBFILES += "${LAYERDIR}/recipes-*/*/*.bb \
	${LAYERDIR}/recipes-*/*/*.bbappend"

BBFILE_COLLECTIONS += "iris-base-hw1"
BBFILE_PATTERN_iris-base-hw1 = "^${LAYERDIR}/"
BBFILE_PRIORITY_iris-base-hw1 = "16"

LAYERDEPENDS_iris-base-hw1 = "core \
                              openembedded-layer \
                              iris-base-common"

LAYERSERIES_COMPAT_iris-base-hw1 = "dunfell"

# enforce layer compatibility on meta-adi layer
LAYERSERIES_COMPAT_adsp-sc5xx_append = " dunfell"
LAYERSERIES_COMPAT_external-toolchain_append = " dunfell"
# remove meta-adi's preferred version of diffutils to prevent warnings
PREFERRED_VERSION_diffutils_remove = "3.3%"
```

## meta-iris-base-hw2/conf/layer.conf
```bitbake
# SPDX-License-Identifier: MIT
# Copyright (C) 2021 iris-GmbH infrared & intelligent sensors

# We have a conf and classes directory, add to BBPATH
BBPATH .= ":${LAYERDIR}"

# We have a recipes-* directories, add to BBFILES
BBFILES += "${LAYERDIR}/recipes-*/*/*.bb \
	${LAYERDIR}/recipes-*/*/*.bbappend"

BBFILE_COLLECTIONS += "iris-base-hw2"
BBFILE_PATTERN_iris-base-hw2 = "^${LAYERDIR}/"
BBFILE_PRIORITY_iris-base-hw2 = "16"

LAYERDEPENDS_iris-base-hw2 = "core \
                              openembedded-layer \
                              iris-base"

LAYERSERIES_COMPAT_iris-base-hw2 = "dunfell"
```
